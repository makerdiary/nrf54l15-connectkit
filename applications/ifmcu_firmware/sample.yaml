## applications/ifmcu_firmware/sample.yaml
```yaml
sample:
  name: IFMCU Firmware
tests:
  applications.ifmcu_firmware:
    sysbuild: true
    build_only: true
    integration_platforms:
      - nrf54l15_connectkit/nrf52820
```

## boards/makerdiary/nrf54l15_connectkit/Kconfig.defconfig
```kconfig
# Copyright (c) 2016-2025 Makerdiary <https://makerdiary.com>
# SPDX-License-Identifier: Apache-2.0

# Workaround for not being able to have commas in macro arguments
DT_CHOSEN_Z_CODE_PARTITION := zephyr,code-partition
DT_CHOSEN_Z_SRAM_PARTITION := zephyr,sram-secure-partition

if BOARD_NRF54L15_CONNECTKIT_NRF54L15_CPUAPP

config ROM_START_OFFSET
	default 0 if PARTITION_MANAGER_ENABLED
	default 0x800 if BOOTLOADER_MCUBOOT

endif #BOARD_NRF54L15_CONNECTKIT_NRF54L15_CPUAPP

if BOARD_NRF54L15_CONNECTKIT_NRF54L15_CPUAPP_NS

config BT_CTLR
	default BT

config FLASH_LOAD_OFFSET
	default $(dt_chosen_reg_addr_hex,$(DT_CHOSEN_Z_CODE_PARTITION))

config FLASH_LOAD_SIZE
	default $(dt_chosen_reg_size_hex,$(DT_CHOSEN_Z_CODE_PARTITION))

# By default, if we build for a Non-Secure version of the board,
# enable building with TF-M as the Secure Execution Environment.
config BUILD_WITH_TFM
	default y

endif #BOARD_NRF54L15_CONNECTKIT_NRF54L15_CPUAPP_NS

if BOARD_NRF54L15_CONNECTKIT_NRF52820

choice CLOCK_CONTROL_NRF_SOURCE
	default CLOCK_CONTROL_NRF_K32SRC_RC
endchoice

endif # BOARD_NRF54L15_CONNECTKIT_NRF52820
```

## boards/makerdiary/nrf54l15_connectkit/Kconfig.nrf54l15_connectkit
```kconfig
# Copyright (c) 2016-2025 Makerdiary <https://makerdiary.com>
# SPDX-License-Identifier: Apache-2.0

config BOARD_NRF54L15_CONNECTKIT
	select SOC_NRF52820_QDAA if BOARD_NRF54L15_CONNECTKIT_NRF52820
	select SOC_NRF54L15_CPUAPP if BOARD_NRF54L15_CONNECTKIT_NRF54L15_CPUAPP || BOARD_NRF54L15_CONNECTKIT_NRF54L15_CPUAPP_NS
	select SOC_NRF54L15_CPUFLPR if BOARD_NRF54L15_CONNECTKIT_NRF54L15_CPUFLPR || \
					    BOARD_NRF54L15_CONNECTKIT_NRF54L15_CPUFLPR_XIP
```

## boards/makerdiary/nrf54l15_connectkit/board.yml
```yaml
board:
  name: nrf54l15_connectkit
  full_name: nRF54L15 Connect Kit
  vendor: makerdiary
  socs:
    - name: nrf52820
    - name: nrf54l15
      variants:
        - name: xip
          cpucluster: cpuflpr
        - name: ns
          cpucluster: cpuapp
```

## samples/adc/sample.yaml
```yaml
sample:
  name: ADC devicetree driver sample
tests:
  sample.adc:
    sysbuild: true
    build_only: true
    integration_platforms:
      - nrf54l15_connectkit/nrf54l15/cpuapp
```

## samples/blinky/sample.yaml
```yaml
sample:
  name: Blinky Sample
tests:
  sample.blinky:
    sysbuild: true
    build_only: true
    integration_platforms:
      - nrf54l15_connectkit/nrf54l15/cpuapp
```

## samples/bluetooth/beacon/sample.yaml
```yaml
sample:
  name: Bluetooth Low Energy Beacon sample
tests:
  sample.bluetooth.beacon:
    sysbuild: true
    build_only: true
    integration_platforms:
      - nrf54l15_connectkit/nrf54l15/cpuapp
```

## samples/bluetooth/channel_sounding_ras_initiator/sample.yaml
```yaml
sample:
  name: Bluetooth LE Channel Sounding Initiator with RREQ
tests:
  sample.bluetooth.channel_sounding_ras_initiator:
    sysbuild: true
    build_only: true
    integration_platforms:
      - nrf54l15_connectkit/nrf54l15/cpuapp
```

## samples/bluetooth/channel_sounding_ras_reflector/sample.yaml
```yaml
sample:
  name: Bluetooth LE Channel Sounding Reflector with RRSP
tests:
  sample.bluetooth.channel_sounding_ras_reflector:
    sysbuild: true
    build_only: true
    integration_platforms:
      - nrf54l15_connectkit/nrf54l15/cpuapp
```

## samples/bluetooth/observer/sample.yaml
```yaml
sample:
  name: Bluetooth Low Energy Observer sample
tests:
  sample.bluetooth.observer:
    sysbuild: true
    build_only: true
    integration_platforms:
      - nrf54l15_connectkit/nrf54l15/cpuapp
  sample.bluetooth.observer.extended:
    sysbuild: true
    build_only: true
    extra_args: CONF_FILE="prj_extended.conf"
    integration_platforms:
      - nrf54l15_connectkit/nrf54l15/cpuapp
```

## samples/bluetooth/peripheral_lbs/sample.yaml
```yaml
sample:
  name: Bluetooth LE LED Button service sample
tests:
  sample.bluetooth.peripheral_lbs:
    sysbuild: true
    build_only: true
    integration_platforms:
      - nrf54l15_connectkit/nrf54l15/cpuapp
  sample.bluetooth.peripheral_lbs_minimal:
    sysbuild: true
    build_only: true
    extra_args: FILE_SUFFIX=minimal
    integration_platforms:
      - nrf54l15_connectkit/nrf54l15/cpuapp
  sample.bluetooth.peripheral_lbs_no_security:
    sysbuild: true
    build_only: true
    extra_args: CONFIG_BT_LBS_SECURITY_ENABLED=n
    integration_platforms:
      - nrf54l15_connectkit/nrf54l15/cpuapp
```

## samples/bluetooth/shell_bt_nus/sample.yaml
```yaml
sample:
  name: BT NUS shell sample
tests:
  sample.bluetooth.shell_bt_nus:
    sysbuild: true
    build_only: true
    integration_platforms:
      - nrf54l15_connectkit/nrf54l15/cpuapp
```

## samples/button/sample.yaml
```yaml
sample:
  name: Button Sample
tests:
  sample.button:
    sysbuild: true
    build_only: true
    integration_platforms:
      - nrf54l15_connectkit/nrf54l15/cpuapp
```

## samples/hello_world/sample.yaml
```yaml
sample:
  name: Hello World Sample
tests:
  sample.helloworld:
    sysbuild: true
    build_only: true
    integration_platforms:
      - nrf54l15_connectkit/nrf54l15/cpuapp
```

## samples/input_dump/sample.yaml
```yaml
sample:
  name: Input dump Sample
tests:
  sample.input_dump:
    sysbuild: true
    build_only: true
    integration_platforms:
      - nrf54l15_connectkit/nrf54l15/cpuapp
```

## samples/nfc/record_text/sample.yaml
```yaml
sample:
  name: NFC Text Record
tests:
  sample.nfc.record_text:
    sysbuild: true
    build_only: true
    integration_platforms:
      - nrf54l15_connectkit/nrf54l15/cpuapp
      - nrf54l15_connectkit/nrf54l15/cpuapp/ns
```

## samples/nfc/system_off/sample.yaml
```yaml
sample:
  name: NFC System OFF sample
tests:
  sample.nfc.system_off:
    sysbuild: true
    build_only: true
    integration_platforms:
      - nrf54l15_connectkit/nrf54l15/cpuapp
```

## samples/openthread/cli/sample.yaml
```yaml
sample:
  name: OpenThread CLI sample
  description: Test OpenThread Command Line Interface.

tests:
  sample.openthread.cli:
    sysbuild: true
    build_only: true
    integration_platforms:
      - nrf54l15_connectkit/nrf54l15/cpuapp
      - nrf54l15_connectkit/nrf54l15/cpuapp/ns
  sample.openthread.cli.multiprotocol:
    sysbuild: true
    build_only: true
    extra_args:
      - cli_SNIPPET="ci;logging;multiprotocol;tcp"
      - FILE_SUFFIX=ble
    integration_platforms:
      - nrf54l15_connectkit/nrf54l15/cpuapp
      - nrf54l15_connectkit/nrf54l15/cpuapp/ns
  sample.openthread.cli.singleprotocol:
    sysbuild: true
    build_only: true
    extra_args: >
      cli_SNIPPET="ci;logging;tcp"
    integration_platforms:
      - nrf54l15_connectkit/nrf54l15/cpuapp
      - nrf54l15_connectkit/nrf54l15/cpuapp/ns
  sample.openthread.cli.low_power:
    sysbuild: true
    build_only: true
    extra_args: >
      cli_SNIPPET="ci;low_power"
    integration_platforms:
      - nrf54l15_connectkit/nrf54l15/cpuapp
      - nrf54l15_connectkit/nrf54l15/cpuapp/ns
  # Build integration regression protection.
  sample.nrf_security.openthread.integration:
    sysbuild: true
    build_only: true
    extra_args:
      - cli_SNIPPET=ci
      - CONFIG_NRF_SECURITY=y
    integration_platforms:
      - nrf54l15_connectkit/nrf54l15/cpuapp
      - nrf54l15_connectkit/nrf54l15/cpuapp/ns
  sample.openthread.cli.tcat:
    sysbuild: true
    build_only: true
    extra_args:
      - cli_SNIPPET="ci;tcat;tcp"
      - FILE_SUFFIX=ble
    integration_platforms:
      - nrf54l15_connectkit/nrf54l15/cpuapp
      - nrf54l15_connectkit/nrf54l15/cpuapp/ns
  sample.openthread.cli.diag_gpio:
    sysbuild: true
    build_only: true
    extra_args: >
      cli_SNIPPET=diag_gpio
    integration_platforms:
      - nrf54l15_connectkit/nrf54l15/cpuapp
      - nrf54l15_connectkit/nrf54l15/cpuapp/ns
```

## samples/openthread/coprocessor/sample.yaml
```yaml
sample:
  name: OpenThread Co-Processor sample

tests:
  sample.openthread.coprocessor:
    sysbuild: true
    build_only: true
    integration_platforms:
      - nrf54l15_connectkit/nrf54l15/cpuapp
      - nrf54l15_connectkit/nrf54l15/cpuapp/ns
  sample.openthread.coprocessor.vendor_hook:
    sysbuild: true
    build_only: true
    extra_args: >
      SNIPPET="ci;logging;vendor_hook"
    integration_platforms:
      - nrf54l15_connectkit/nrf54l15/cpuapp
      - nrf54l15_connectkit/nrf54l15/cpuapp/ns
```

## samples/sensor/bme68x_iaq/sample.yaml
```yaml
sample:
  name: BME68X Sensor Sample
tests:
  sample.sensor.bme68x_iaq:
    sysbuild: true
    build_only: true
    integration_platforms:
      - nrf54l15_connectkit/nrf54l15/cpuapp
```

## samples/sensor/die_temp_polling/sample.yaml
```yaml
sample:
  name: CPU Die temperature polling sample
tests:
  sample.sensor.die_temp_polling:
    sysbuild: true
    build_only: true
    integration_platforms:
      - nrf54l15_connectkit/nrf54l15/cpuapp
```

## samples/shell/sample.yaml
```yaml
sample:
  name: Shell Sample
tests:
  sample.shell:
    sysbuild: true
    build_only: true
    integration_platforms:
      - nrf54l15_connectkit/nrf54l15/cpuapp
```

## samples/system_off/sample.yaml
```yaml
sample:
  name: System OFF sample
tests:
  sample.system_off:
    sysbuild: true
    build_only: true
    integration_platforms:
      - nrf54l15_connectkit/nrf54l15/cpuapp
  sample.system_off.retained_mem:
    sysbuild: true
    build_only: true
    integration_platforms:
      - nrf54l15_connectkit/nrf54l15/cpuapp
    extra_configs:
      - CONFIG_APP_USE_RETAINED_MEM=y
  sample.system_off.grtc_wakeup:
    sysbuild: true
    build_only: true
    integration_platforms:
      - nrf54l15_connectkit/nrf54l15/cpuapp
    extra_configs:
      - CONFIG_GRTC_WAKEUP_ENABLE=y
      - CONFIG_GPIO_WAKEUP_ENABLE=n
  sample.system_off.retained_mem.grtc_wakeup:
    sysbuild: true
    build_only: true
    integration_platforms:
      - nrf54l15_connectkit/nrf54l15/cpuapp
    extra_configs:
      - CONFIG_APP_USE_RETAINED_MEM=y
      - CONFIG_GRTC_WAKEUP_ENABLE=y
      - CONFIG_GPIO_WAKEUP_ENABLE=n
  sample.system_off.lpcomp_wakeup:
    sysbuild: true
    build_only: true
    integration_platforms:
      - nrf54l15_connectkit/nrf54l15/cpuapp
    extra_args: DTC_OVERLAY_FILE="boards/nrf54l15_connectkit_nrf54l15_cpuapp_comparator.overlay"
    extra_configs:
      - CONFIG_LPCOMP_WAKEUP_ENABLE=y
      - CONFIG_GPIO_WAKEUP_ENABLE=n
      - CONFIG_COMPARATOR=y
  sample.system_off.retained_mem.lpcomp_wakeup:
    sysbuild: true
    build_only: true
    integration_platforms:
      - nrf54l15_connectkit/nrf54l15/cpuapp
    extra_args:
      - "DTC_OVERLAY_FILE=
         boards/nrf54l15_connectkit_nrf54l15_cpuapp_comparator.overlay;
         boards/nrf54l15_connectkit_nrf54l15_cpuapp.overlay"
    extra_configs:
      - CONFIG_APP_USE_RETAINED_MEM=y
      - CONFIG_GPIO_WAKEUP_ENABLE=n
      - CONFIG_LPCOMP_WAKEUP_ENABLE=y
      - CONFIG_RETAINED_MEM=y
      - CONFIG_COMPARATOR=y
```
