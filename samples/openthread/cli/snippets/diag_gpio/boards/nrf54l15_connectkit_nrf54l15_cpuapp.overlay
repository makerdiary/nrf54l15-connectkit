/* Copyright (c) 2024 Nordic Semiconductor ASA
 *
 * SPDX-License-Identifier: LicenseRef-Nordic-5-Clause
 */

/ {
	openthread_config: openthread {
		compatible = "openthread,config";
		diag-gpios = <&gpio0 2 GPIO_ACTIVE_HIGH>,		    // LED 0
			     <&gpio0 3 (GPIO_PULL_UP | GPIO_ACTIVE_LOW)>;  // Button 0
	};
};
